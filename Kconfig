## Kconfig
```kconfig
menuconfig VELVET_DISPLAY_POWER
    bool "Velvet display backlight power control"
    depends on ZMK_DISPLAY && SHIELD_PROSPECTOR_ADAPTER && !PROSPECTOR_USE_AMBIENT_LIGHT_SENSOR
    help
      Turn the Prospector backlight off when ZMK blanks the display and
      optionally enforce a minimum activity idle timeout.

if VELVET_DISPLAY_POWER

config VELVET_MIN_IDLE_TIMEOUT_MS
    int "Minimum activity idle timeout (ms, 0 = leave unchanged)"
    default 0
    range 0 3600000

endif
```

## boards/shields/velvet/Kconfig.defconfig
```kconfig
# Copyright (c) 2020 The ZMK Contributors
# SPDX-License-Identifier: MIT

if SHIELD_VELVET_CENTRAL_DONGLE

config ZMK_KEYBOARD_NAME
    default "Velvet"

config ZMK_SPLIT_ROLE_CENTRAL
    default y

endif

if SHIELD_VELVET_CENTRAL_DONGLE || SHIELD_VELVET_PERIPHERAL_LEFT || SHIELD_VELVET_PERIPHERAL_RIGHT

config ZMK_SPLIT
    default y

endif

if SHIELD_VELVET_PERIPHERAL_LEFT || SHIELD_VELVET_PERIPHERAL_RIGHT

config ZMK_KEYBOARD_DEBOUNCE
    default 4

endif
```

## config/west.yml
```yaml
manifest:
  remotes:
    - name: cormoran
      url-base: https://github.com/cormoran
    - name: zmkfirmware
      url-base: https://github.com/zmkfirmware
    - name: badjeff
      url-base: https://github.com/badjeff
    - name: mctechnology17
      url-base: https://github.com/mctechnology17
    - name: eyelash
      url-base: https://github.com/a741725193
    - name: infused-kim
      url-base: https://github.com/infused-kim
    - name: a741725193
      url-base: https://github.com/a741725193
    - name: tokyo2006
      url-base: https://github.com/tokyo2006
   
  projects:
    - name: zmk
      remote: cormoran
      revision: v0.3-branch+dya
      import: app/west.yml
    - name: zmk-behavior-runtime-sensor-rotate
      remote: cormoran
      revision: main # or latest commit hash
    # Trackball: PMW3610 — replaced by the TPS43 trackpad on this branch
    # - name: zmk-pmw3610-driver
    #   remote: cormoran
    #   revision: zmk-v0.3.0.0
    # TPS43 (Azoteq IQS5xx) trackpad
    # No `import: true`: the module's transitive zmk-feature-custom-settings
    # dependency is only needed for custom-settings persistence, which this
    # branch does not enable.
    - name: tps43-input-module
      remote: tokyo2006
      revision: main
    - name: zmk-module-ble-management
      remote: cormoran
      revision: zmk-v0.3.0.0
    - name: zmk-module-battery-history
      remote: cormoran
      revision: main
    - name: zmk-module-settings-rpc
      remote: cormoran
      revision: main
    - name: zmk-module-runtime-input-processor
      remote: cormoran
      revision: zmk-v0.3.0.0
   
    - name: zmk-tog-io
      remote: a741725193
      revision: main
  self:
    path: config
```
