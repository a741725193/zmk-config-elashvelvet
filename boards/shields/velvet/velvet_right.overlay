/*
 * Copyright (c) 2020 The ZMK Contributors
 *
 * SPDX-License-Identifier: MIT
 */
#include "velvet.dtsi"
// Trackball — replaced by the TPS43 trackpad on this branch
// #include "trackball.dtsi"
#include "tps43.dtsi"
#include <behaviors/battery_history_request.dtsi>

&default_transform {
	col-offset = <7>;
};

&kscan0 {
    compatible = "zmk,kscan-gpio-matrix";
    row-gpios
	= <&gpio0 10 (GPIO_ACTIVE_HIGH | GPIO_PULL_DOWN)>
	, <&gpio0 22 (GPIO_ACTIVE_HIGH | GPIO_PULL_DOWN)>
	, <&gpio0 8 (GPIO_ACTIVE_HIGH | GPIO_PULL_DOWN)>
	, <&gpio0 2 (GPIO_ACTIVE_HIGH | GPIO_PULL_DOWN)>
	;
    col-gpios
        = <&gpio1 4  GPIO_ACTIVE_HIGH>
        , <&gpio0 31  GPIO_ACTIVE_HIGH>
        , <&gpio0 29  GPIO_ACTIVE_HIGH>
        , <&gpio1 15  GPIO_ACTIVE_HIGH>
        , <&gpio1 6  GPIO_ACTIVE_HIGH>
        , <&gpio1 11  GPIO_ACTIVE_HIGH>
        ;
};

/ {
    /* TPS43 trackpad input listener (replaces the PMW3610 trackball listener) */
    tps43_input: tps43_input {
        compatible = "zmk,input-listener";
        device = <&tps43>;
    };
};
