## boards/shields/velvet/Kconfig.shield
```kconfig
# Copyright (c) 2020 The ZMK Contributors
# SPDX-License-Identifier: MIT

config SHIELD_VELVET_LEFT
    def_bool $(shields_list_contains,velvet_left)

config SHIELD_VELVET_RIGHT
    def_bool $(shields_list_contains,velvet_right)
```
